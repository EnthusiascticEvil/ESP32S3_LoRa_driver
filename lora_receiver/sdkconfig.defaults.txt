## lora_receiver/sdkconfig.defaults.txt
```kconfig
CONFIG_IDF_TARGET="esp32s3"
CONFIG_ESP_CONSOLE_UART_NUM=0
CONFIG_ESP_CONSOLE_UART_BAUDRATE=115200
CONFIG_LOG_DEFAULT_LEVEL_INFO=y
CONFIG_PARTITION_TABLE_SINGLE_APP=y
CONFIG_COMPILER_OPTIMIZATION_DEFAULT=y
CONFIG_FREERTOS_UNICORE=n
CONFIG_FREERTOS_HZ=1000
CONFIG_FREERTOS_USE_TICKLESS_IDLE=n
CONFIG_SPI_MASTER_ISR_IN_IRAM=y
CONFIG_SPI_MASTER_IN_IRAM=y
CONFIG_SPI_FLASH_ROM_DRIVER_PATCH=y
CONFIG_FREERTOS_ASSERT_ON_UNTESTED_FUNCTION=n
CONFIG_ESP_TIMER_TASK_STACK_SIZE=4096
CONFIG_MAIN_TASK_STACK_SIZE=8192
```
